// SpaceInvaders.c
// Runs on LM4F120/TM4C123
// Akaash Chikarmane and Milan Feliciello
// This is a starter project for the EE319K Lab 10

// Last Modified: 5/10/2016
/* This example accompanies the books
   "Embedded Systems: Real Time Interfacing to Arm Cortex M Microcontrollers",
   ISBN: 978-1463590154, Jonathan Valvano, copyright (c) 2014

   "Embedded Systems: Introduction to Arm Cortex M Microcontrollers",
   ISBN: 978-1469998749, Jonathan Valvano, copyright (c) 2014

 Copyright 2015 by Jonathan W. Valvano, valvano@mail.utexas.edu
    You may use, edit, run or distribute this file
    as long as the above copyright notice remains
 THIS SOFTWARE IS PROVIDED "AS IS".  NO WARRANTIES, WHETHER EXPRESS, IMPLIED
 OR STATUTORY, INCLUDING, BUT NOT LIMITED TO, IMPLIED WARRANTIES OF
 MERCHANTABILITY AND FITNESS FOR A PARTICULAR PURPOSE APPLY TO THIS SOFTWARE.
 VALVANO SHALL NOT, IN ANY CIRCUMSTANCES, BE LIABLE FOR SPECIAL, INCIDENTAL,
 OR CONSEQUENTIAL DAMAGES, FOR ANY REASON WHATSOEVER.
 For more information about my classes, my research, and my books, see
 http://users.ece.utexas.edu/~valvano/
 */
// *******Hardware I/O connections*******************
// Slide pot pin 1 connected to ground
// Slide pot pin 2 connected to PE2/AIN1
// Slide pot pin 3 connected to +3.3V 
// fire button connected to PE0
// special weapon fire button connected to PE1
// 8*R resistor DAC bit 0 on PB0 (least significant bit)
// 4*R resistor DAC bit 1 on PB1
// 2*R resistor DAC bit 2 on PB2
// 1*R resistor DAC bit 3 on PB3 (most significant bit)

// Backlight (pin 10) connected to +3.3 V
// MISO (pin 9) unconnected
// SCK (pin 8) connected to PA2 (SSI0Clk)
// MOSI (pin 7) connected to PA5 (SSI0Tx)
// TFT_CS (pin 6) connected to PA3 (SSI0Fss)
// CARD_CS (pin 5) unconnected
// Data/Command (pin 4) connected to PA6 (GPIO), high for data, low for command
// RESET (pin 3) connected to PA7 (GPIO)
// VCC (pin 2) connected to +3.3 V
// Gnd (pin 1) connected to ground

#include <stdint.h>
#include "tm4c123gh6pm.h"
#include "ST7735.h"
#include "Random.h"
#include "TExaS.h"
#include "ADC.h"
#include "DAC.h"
#include "Timer1.h"
#include "Timer0.h"

#include "Sound.h"


void DisableInterrupts(void); // Disable interrupts
void EnableInterrupts(void);  // Enable interrupts
void Delay100ms(uint32_t count); // time delay in 0.1 seconds
void Positionchange(void);
void Patt_Init (void);
void NewGame(void);
void EndGame(void);
void SwitchLED_Init(void);
uint32_t Convert(uint32_t);
uint8_t CollisionTB(void);
uint8_t CollisionLR(void);
uint8_t CollisionTBH(void);
uint8_t CollisionLRH(void);
uint8_t CollisionBH(void);
void WinGame(void);


struct Patt{
	uint8_t xPos[7];
	uint8_t yPos[7];
	int8_t xDir[7];		//consider -1 means left, 1 means right 0 means no movement
	int8_t yDir[7];		// -1 means down 1 means up 0 means no movement
	uint8_t Speed[7];// x y Down/Up Left/Right
};
typedef struct Patt stype;		//redefines the struct type Patt as stype so we can use Patt in next line
stype Patt;					//allocates space for the Patt struct

struct Yerraballer{
	uint8_t xPos;
	uint8_t yPos;
	uint8_t xBall;
	uint8_t yBall;
	uint8_t Speed;
	uint8_t Ball;
};
typedef struct Yerraballer player;
player Yerraballer;

uint8_t PattH = 26;
uint8_t PattW = 24;
uint8_t YerrH = 26;
uint8_t YerrW = 24;
uint8_t BallH = 12;
uint8_t BallW = 12;
uint8_t GameScore=0;
uint8_t Updatescreen =0;
uint8_t PattNum = 1;
int8_t MoveYerraballi = 0;
uint32_t FallingEdges = 0;
uint8_t collTB = 0;
uint8_t collLR = 0;
uint8_t HoopH = 30;
uint8_t HoopW = 30;
uint8_t data;
uint16_t s = 0;
uint16_t i = 0;
uint8_t whichsound = 0;//0 = dribble, 1 = new level

// *************************** Images ***************************
const unsigned short PattImage[] = {
 0x451F, 0x451F, 0x451F, 0x451F, 0x451F, 0x451F, 0x451F, 0x451F, 0x451F, 0x451F, 0x451F, 0x451F, 0x451F, 0x451F, 0x451F, 0x451F,
 0x451F, 0x451F, 0x451F, 0x451F, 0x451F, 0x451F, 0x451F, 0x451F, 0x451F, 0x451F, 0x451F, 0x451F, 0x451F, 0x451F, 0x451F, 0x451F,
 0x451F, 0x451F, 0x451F, 0x451F, 0x451F, 0x451F, 0x451F, 0x451F, 0x451F, 0x451F, 0x451F, 0x451F, 0x451F, 0x451F, 0x451F, 0x451F,
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 0x451F, 0x451F, 0x451F, 0x451F, 0x451F, 0x451F, 0x451F, 0x451F, 0x451F, 0x451F, 0x451F, 0x451F, 0x451F, 0x451F, 0x451F, 0x451F,
};

const unsigned short YerraballerImage[] = {
 0x451F, 0x451F, 0x451F, 0x451F, 0x451F, 0x451F, 0x451F, 0x451F, 0x451F, 0x451F, 0x451F, 0x451F, 0x451F, 0x451F, 0x451F, 0x451F,
 0x451F, 0x451F, 0x451F, 0x451F, 0x451F, 0x451F, 0x451F, 0x451F, 0x451F, 0x451F, 0x451F, 0x451F, 0x451F, 0x451F, 0x451F, 0x451F,
 0x451F, 0x451F, 0x451F, 0x451F, 0x451F, 0x451F, 0x451F, 0x451F, 0x451F, 0x451F, 0x451F, 0x451F, 0x451F, 0x451F, 0x451F, 0x451F,
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 0x451F, 0x451F, 0x451F, 0x451F, 0x451F, 0x451F, 0x451F, 0x451F, 0x451F, 0x451F, 0x451F, 0x451F, 0x451F, 0x451F, 0x451F, 0x451F,
};

const unsigned short hoop[] = {
 0x451F, 0x451F, 0x451F, 0x451F, 0x451F, 0x451F, 0x451F, 0x451F, 0x451F, 0x451F, 0x451F, 0x451F, 0x451F, 0x451F, 0x738E, 0x451F,
 0x451F, 0x451F, 0x451F, 0x451F, 0x451F, 0x451F, 0x451F, 0x451F, 0x451F, 0x451F, 0x451F, 0x451F, 0x451F, 0x451F, 0x451F, 0x451F,
 0x451F, 0x451F, 0x451F, 0x451F, 0x451F, 0x451F, 0x451F, 0x451F, 0x451F, 0x451F, 0xB5B6, 0xFFFF, 0x52AA, 0x2104, 0x5AEB, 0xFFFF,
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 0x451F, 0x451F, 0x451F, 0x451F,

};
const unsigned short ball[] = {
 0x451F, 0x451F, 0x451F, 0x451F, 0x451F, 0x451F, 0x451F, 0x451F, 0x451F, 0x451F, 0x451F, 0x451F, 0x451F, 0x451F, 0x451F, 0x451F,
 0x451F, 0x451F, 0x451F, 0x451F, 0x451F, 0x451F, 0x451F, 0x451F, 0x451F, 0x451F, 0x451F, 0x0000, 0x0000, 0x0000, 0x0000, 0x0000,
 0x451F, 0x451F, 0x451F, 0x451F, 0x451F, 0x451F, 0x0000, 0x0276, 0x0276, 0x0276, 0x0000, 0x0000, 0x0000, 0x0000, 0x451F, 0x451F,
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 0x451F, 0x451F, 0x451F, 0x451F, 0x451F, 0x451F, 0x451F, 0x451F, 0x451F, 0x451F, 0x451F, 0x451F, 0x451F, 0x451F, 0x451F, 0x451F,
};


const unsigned short nbalogo_utsmall2[] = {
 0x2B98, 0x2B98, 0x1BBA, 0x3354, 0xA1E0, 0x9A00, 0x9A00, 0x9A00, 0x9A00, 0x9A00, 0x9A00, 0x9A00, 0x9A00, 0x9A00, 0x9A00, 0x9A00,
 0x9A00, 0x9A00, 0xAA20, 0x9A62, 0x03FF, 0x23BA, 0x2B98, 0x2B98, 0x2B98, 0x2399, 0x12F6, 0x9309, 0xE634, 0xE636, 0xE636, 0xE636,
 0xE636, 0xE636, 0xE636, 0xE636, 0xE636, 0xE636, 0xE636, 0xE636, 0xE636, 0xE616, 0xE635, 0xAB23, 0x6A48, 0x7AC8, 0x2399, 0x2B98,
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 0xCCAB, 0xCCAC, 0xC48B, 0xA220, 0x8A85, 0x532F, 0x2399, 0x2B98,

};


// *************************** Sounds ***************************
unsigned char basketballdribble2[5219] = {31,31,31,31,31,31,31,31,31,31,31,31,31,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31,31};

unsigned char newlevel2[9236] = {45,43,41,44,44,45,41,44,43,45,43,48,50,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37,36};
	
// *************************** Capture image dimensions out of BMP**********

int main(void){
	DisableInterrupts();
  TExaS_Init();  // set system clock to 80 MHz
	ST7735_InitR(INITR_REDTAB);
  Random_Init(1);
  Output_Init();
	Sound_Init();
	SwitchLED_Init();
	ADC_Init();
	ST7735_FillScreen(0x2B98);
	ST7735_DrawBitmap(52, 111, nbalogo_utsmall2, 24, 61);
	Delay100ms(25);
	ST7735_FillScreen(0x451F);            // set screen to court color
	Timer1_Init();
	Timer0_Init();
	Patt_Init();
	Yerraballer.Speed = 1;
	EnableInterrupts();
	whichsound = 1;
	ST7735_SetCursor(3, 0);
	ST7735_OutString("Press to Play");																									//newlines
	while((GPIO_PORTE_DATA_R & 0x08) == 0){};																						//newlines
	ST7735_FillScreen(0x451F);																													//newlines
	whichsound = 0;
  while(1){ 
		if(Updatescreen==1){
			DisableInterrupts();
			uint8_t n=PattNum;
			uint8_t i = 0;
			while(n!=0){
				ST7735_DrawBitmap(Patt.xPos[i],Patt.yPos[i],PattImage,PattW,PattH);
				n--;
				i++;
			}
			ST7735_DrawBitmap(Yerraballer.xPos,Yerraballer.yPos, YerraballerImage, YerrW, YerrH);
			if(Yerraballer.Ball != 0){
				ST7735_DrawBitmap (Yerraballer.xBall,Yerraballer.yBall, ball, BallW, BallH);
			}
			ST7735_DrawBitmap(49, 30, hoop, 30, 30);
			Updatescreen = 0;
			EnableInterrupts();
		} 
  }
}

void Positionchange (void){		// NEW NEW NEW NEW NEW NEW NEW		
	uint8_t n=0, i=0;
	collTB = CollisionTB();
	collLR = CollisionLR();
	if((collTB + collLR) != 0){
		EndGame();
	}
	if((CollisionTBH() + CollisionLRH()) != 0){
		WinGame();
	}
	if(Yerraballer.Ball !=0){
		if(((Yerraballer.yBall-BallH)<31) && (Yerraballer.xBall>48) && ((Yerraballer.xBall + 12)<=80)){
			Yerraballer.Ball=0;
			WinGame();
		}
		if((Yerraballer.yBall-BallH)==0){
			Yerraballer.Ball=0;
			ST7735_FillRect((int16_t) Yerraballer.xBall,(int16_t) (Yerraballer.yBall - 12), 12, 14, 0x451F);
		}
	}
	if(((GPIO_PORTE_DATA_R & 0x02) != 0) & (Yerraballer.yPos > 160)){
			MoveYerraballi = 0;
	}
	n=PattNum;
	while(n!=0){
		if((Patt.xPos[i]==0) || (Patt.xPos[i]==103) || (Patt.yPos[i]==26) || (Patt.yPos[i] == 130)){	
			Patt.xDir[i]=(Patt.xDir[i])*(-1);
			Patt.yDir[i]=(Patt.yDir[i])*(-1);
		}
		Patt.xPos[i]=(Patt.xPos[i])+(Patt.xDir[i]);
		Patt.yPos[i]=(Patt.yPos[i])+(Patt.yDir[i]);
		i++;
		n--;
	}
	if(Yerraballer.xPos != Convert(ADC_In())){
		if(Yerraballer.xPos > 104 - Convert(ADC_In())){
			Yerraballer.xPos = Yerraballer.xPos - Yerraballer.Speed;
		}
		if(Yerraballer.xPos < 104 - Convert(ADC_In())){
			Yerraballer.xPos = Yerraballer.xPos + Yerraballer.Speed;
		}
	}
	if((MoveYerraballi==1) & ((Yerraballer.yPos - YerrH) > 0)){
		Yerraballer.yPos = Yerraballer.yPos - Yerraballer.Speed;
	}
	if((MoveYerraballi==-1) & ((Yerraballer.yPos) != 0)){
		Yerraballer.yPos = Yerraballer.yPos + Yerraballer.Speed;
	}
	if(Yerraballer.Ball !=0){
		Yerraballer.yBall = Yerraballer.yBall-2;
	}
}	

void Patt_Init (void){		// NEW NEW NEW NEW NEW NEW NEW
	int8_t num=0;
	uint8_t i=0, n=0;
	Yerraballer.Ball = 0;
	n=PattNum;
	while(n != 0){
		Patt.xPos[i] = (Random())%104;
		Patt.yPos[i]= 20 + (Random())%115;// a number from 0 to 127		
		num=(Random())%3;
		if(num==2){	// will return 0 1 or 2, if it is a 2 make it a -1
			num=(-1);
		}
		Patt.xDir[i]=num;
	
		num=(Random())%3;
		if(num==2){	// will return 0 1 or 2, if it is a 2 make it a -1
			num=(-1);
		}
		Patt.yDir[i]=num;
		if(((Patt.yPos[i] - PattH)<31) && (Patt.xPos[i]>48) && (Patt.xPos[i]<80)){
			Patt.yPos[i] = Patt.yPos[i] + 30;
		}
		i++;
		n--;
	}
	Yerraballer.xPos = 104 - Convert(ADC_In());
	Yerraballer.yPos = 158;
	Yerraballer.Speed = 2;
}

void NewGame(void){
	DisableInterrupts();
	ST7735_FillScreen(0x451F);
	Patt_Init();
	collTB = 0;
	collLR = 0;
	ST7735_SetCursor(7,4);
	ST7735_OutString("LEVEL: ");
	LCD_OutDec(GameScore);
	GPIO_PORTE_DATA_R &= ~0x30;
	EnableInterrupts();
	while((GPIO_PORTE_DATA_R & 0x08) == 0){}
	whichsound = 0;
	ST7735_FillScreen(0x451F);
}

void WinGame(void){
	GPIO_PORTE_DATA_R |= 0x20;
	PattNum++;
	GameScore++;
	whichsound = 1;
	//while((GPIO_PORTE_DATA_R & 0x08) == 0){														//sound for NEWLEVEL
		//NVIC_ST_CTRL_R |= 0x00000007;																	//
	//}																																	//
	//NVIC_ST_CTRL_R = 0;
	NewGame();
}

void EndGame (void){
	DisableInterrupts();
	GPIO_PORTE_DATA_R |= 0x10;
	ST7735_FillScreen(0x2B98);            // set screen to black
  ST7735_SetCursor(1, 1);
  ST7735_OutString("SCORE");
	ST7735_SetCursor (1,2);
	LCD_OutDec(GameScore);
	ST7735_SetCursor(3,4);
  ST7735_OutString("PRESS BUTTTON 3");
	ST7735_SetCursor(4,5);
	ST7735_OutString("TO PLAY AGAIN");
	PattNum = 1;
	GameScore=0;
	ST7735_DrawBitmap(52, 150, nbalogo_utsmall2, 24, 61);
	Delay100ms(40);
	while((GPIO_PORTE_DATA_R & 0x08) == 0){}
	NewGame();
	EnableInterrupts();
}

void SysTick_Handler(void){
	if(whichsound == 0){
		data = basketballdribble2[s];
		s = (s+1)%5219;//replace mod with the size of the array
		DAC_Out(data);
	}
	if(whichsound == 1){
		data = newlevel2[i];
		i = (i+1)%9236;//replace mod with the size of the array
		DAC_Out(data);
	}
}

uint8_t CollisionTB(void){
	uint8_t collision = 0;
	for(uint8_t i = 0; i<PattNum; i++){
		if(Yerraballer.yPos == (Patt.yPos[i] - PattH)){		//if BOTTOM of Yerraballi on same Y level as TOP of Patt
			for(uint8_t n = 0; n<YerrW; n++){		//checks if any of the bottom of Yerr is in the same X as top of Patt
				if((Patt.xPos[i]) == (Yerraballer.xPos + n)){
					collision++;
				}
				if((Patt.xPos[i] + PattW) == (Yerraballer.xPos + n)){
					collision++;
				}
			}
		}
		if((Yerraballer.yPos - YerrH) == Patt.yPos[i]){		//if TOP of Yerraballi on same Y level as BOTTOM of Patt
			for(uint8_t n = 0; n<YerrW; n++){		//checks if any of top of Yerr is in the same X as bottom of Patt
				if((Patt.xPos[i]) == (Yerraballer.xPos + n)){
					collision++;
				}
				if((Patt.xPos[i] + PattW) == (Yerraballer.xPos + n)){
					collision++;
				}
			}
		}
	}
	return(collision);
}

uint8_t CollisionLR(void){
	uint8_t collision = 0;
	for(uint8_t i = 0; i<PattNum; i++){
		if(Yerraballer.xPos == (Patt.xPos[i] + PattW)){		//if LEFT of Yerraballi on same X level as RIGHT of Patt
			for(uint8_t n = 0; n<YerrH; n++){		//checks if any of the left of Yerraballi is in the same Y as right of Patt
				if((Patt.yPos[i]) == (Yerraballer.yPos - n)){
					collision++;
				}
				if((Patt.yPos[i] - PattH) == (Yerraballer.yPos - n)){
					collision++;
				}
			}
		}
		if((Yerraballer.xPos + YerrW) == Patt.xPos[i]){		//if RIGHT of Yerraballi on same X level as LEFT of Patt
			for(uint8_t n = 0; n<YerrH; n++){		//checks if any of top of Yerraballi is in the sae Y as bottom of Patt
				if((Patt.yPos[i]) == (Yerraballer.yPos - n)){
					collision++;
				}
				if((Patt.yPos[i] - PattH) == (Yerraballer.yPos - n)){
					collision++;
				}
			}
		}
	}
	return(collision);
}

uint8_t CollisionTBH(void){
	uint8_t collision = 0;
		if(Yerraballer.yPos == (30 - HoopH)){
			for(uint8_t n = 0; n<YerrW; n++){
				if(49 == (Yerraballer.xPos + n)){
					collision++;
				}
				if((49 + HoopW) == (Yerraballer.xPos + n)){
					collision++;
				}
			}
		}
		if((Yerraballer.yPos - YerrH) == 30){
			for(uint8_t n = 0; n<YerrW; n++){
				if(49 == (Yerraballer.xPos + n)){
					collision++;
				}
				if((49 + HoopW) == (Yerraballer.xPos + n)){
					collision++;
				}
			}
		}
		if((Yerraballer.yPos - YerrH) == 30){
			for(uint8_t n = 0; n<YerrW; n++){
				if(64 == (Yerraballer.xPos + n)){
					collision++;
				}
			}
		}
	return(collision);
}

uint8_t CollisionLRH(void){
	uint8_t collision = 0;
		if(Yerraballer.xPos == (49 + HoopW)){		//if LEFT of Yerraballi on same X level as RIGHT of Patt
			for(uint8_t n = 0; n<YerrH; n++){		//checks if any of the left of Yerraballi is in the same Y as right of Patt
				if((30) == (Yerraballer.yPos - n)){
					collision++;
				}
				if((30 - HoopH) == (Yerraballer.yPos - n)){
					collision++;
				}
				if(15 == Yerraballer.yPos - n){
					collision++;
				}
			}
		}
		if((Yerraballer.xPos + YerrW) == 49){		//if RIGHT of Yerraballi on same X level as LEFT of Patt
			for(uint8_t n = 0; n<YerrH; n++){		//checks if any of top of Yerraballi is in the sae Y as bottom of Patt
				if(30 == (Yerraballer.yPos - n)){
					collision++;
				}
				if((30 - HoopH) == (Yerraballer.yPos - n)){
					collision++;
				}
				if(15 == (Yerraballer.yPos - n)){
					collision++;
				}
			}
		}
	return(collision);
}

void Delay100ms(uint32_t count){
	uint32_t volatile time;
  while(count>0){
    time = 727240;  // 0.1sec at 80 MHz
    while(time){
	  	time--;
    }
    count--;
  }
}

void Timer1A_Handler(void){
	DisableInterrupts();
  TIMER1_ICR_R = TIMER_ICR_TATOCINT;// acknowledge TIMER1A timeout
  Updatescreen=1;
	if(((GPIO_PORTE_DATA_R & 0x08)!=0) & (Yerraballer.yPos <= 110)){
		Yerraballer.Ball=1;
		ST7735_FillRect((int16_t) Yerraballer.xBall,(int16_t) (Yerraballer.yBall - BallH), 12, 12, 0x451F);
		Yerraballer.xBall=Yerraballer.xPos + 6;
		Yerraballer.yBall=Yerraballer.yPos - YerrH;
	}
	EnableInterrupts();
}

void Timer0A_Handler(void){
	DisableInterrupts();
  TIMER0_ICR_R = TIMER_ICR_TATOCINT;// acknowledge TIMER0A timeout
  Positionchange();
	EnableInterrupts();
}

void SwitchLED_Init(void){
	SYSCTL_RCGC2_R |= 0x10;
	FallingEdges = 0;
	GPIO_PORTE_DIR_R &= ~0x08;		//PE3 = game switch
	GPIO_PORTE_DIR_R |= 0x30;			//PE4-5 = LED
	GPIO_PORTE_DEN_R |= 0x38;
	GPIO_PORTE_AFSEL_R &= ~0x38;
	
	GPIO_PORTE_DIR_R &= ~0x03;    // (c) make PE0-1 in (built-in button)
  GPIO_PORTE_AFSEL_R &= ~0x03;  //     disable alt funct on PE0-1
  GPIO_PORTE_DEN_R |= 0x03;     //     enable digital I/O on PE0-1
  GPIO_PORTE_PCTL_R &= ~0x000000FF; //  configure PE0-1 as GPIO
  GPIO_PORTE_AMSEL_R &= ~0x03;  //    disable analog functionality on PE0-1
  GPIO_PORTE_IS_R &= ~0x03;     // (d) PE0-1 is edge-sensitive
  GPIO_PORTE_IBE_R |= 0x03;    //     PE0-1 is both edges
  GPIO_PORTE_ICR_R = 0x03;      // (e) clear flag0-1
  GPIO_PORTE_IM_R |= 0x03;      // (f) arm interrupt on PE0-1
  NVIC_PRI1_R = (NVIC_PRI1_R&0xFFFFFF00)|0x000000A0; // (g) priority 5
  NVIC_EN0_R = 0x00000010;      // (h) enable interrupt 30 in NVIC
}

void GPIOPortE_Handler(void){
	DisableInterrupts();
	//GPIO_PORTE_ICR_R = 0x03;
	if((GPIO_PORTE_RIS_R & 0x01) != 0){
		MoveYerraballi = 1;
	}
	if(((GPIO_PORTE_RIS_R & 0x02) != 0)){
		MoveYerraballi = -1;	
	}
	if((GPIO_PORTE_DATA_R & 0x03) == 0){
		MoveYerraballi = 0;
	}
	GPIO_PORTE_ICR_R = 0x03;
	EnableInterrupts();
}

uint32_t Convert(uint32_t input){
  uint32_t converted;
	converted = input*1;
	converted = (converted + 292);
	converted = (converted/43);

	return(converted);
}
